## scenehub_node_v1/esp_idf/components/node_driver_nfc_reader/Kconfig
```kconfig
menu "SceneHub Node NFC reader"

config SCENEHUB_NODE_DRIVER_PN532_ENABLED
    bool "Enable PN532 NFC reader"
    default n
    help
        Enable compile-time PN532 NFC reader configuration and runtime polling
        over I2C for one bounded reader instance.

if SCENEHUB_NODE_DRIVER_PN532_ENABLED

config SCENEHUB_NODE_DRIVER_PN532_I2C_SDA_GPIO
    int "PN532 I2C SDA GPIO"
    default -1

config SCENEHUB_NODE_DRIVER_PN532_I2C_SCL_GPIO
    int "PN532 I2C SCL GPIO"
    default -1

config SCENEHUB_NODE_DRIVER_PN532_RESET_GPIO
    int "PN532 reset GPIO"
    default -1
    help
        Optional PN532 reset pin. Leave -1 when the module reset line is not
        connected.

config SCENEHUB_NODE_DRIVER_PN532_I2C_ADDRESS
    hex "PN532 I2C address"
    default 0x24
    help
        Default 7-bit PN532 I2C address.

config SCENEHUB_NODE_DRIVER_PN532_POLL_INTERVAL_MS
    int "PN532 poll interval ms"
    range 20 5000
    default 100

config SCENEHUB_NODE_DRIVER_PN532_DEBOUNCE_MS
    int "PN532 debounce ms"
    range 0 5000
    default 250

endif

endmenu
```

## scenehub_node_v1/esp_idf/sdkconfig.defaults.esp32s3
```kconfig
CONFIG_ESP_MAIN_TASK_STACK_SIZE=3584
CONFIG_ESP_SYSTEM_EVENT_TASK_STACK_SIZE=2304
CONFIG_ESP_TIMER_TASK_STACK_SIZE=3584
CONFIG_SPIRAM=y
CONFIG_SPIRAM_BOOT_INIT=y
CONFIG_SPIRAM_MODE_OCT=y
CONFIG_SPIRAM_TYPE_ESPPSRAM64=y
CONFIG_SPIRAM_SPEED_80M=y
CONFIG_SPIRAM_USE_MALLOC=y
CONFIG_SPIRAM_ALLOW_STACK_EXTERNAL_MEMORY=y
CONFIG_SPIRAM_MALLOC_ALWAYSINTERNAL=16384
CONFIG_SPIRAM_MALLOC_RESERVE_INTERNAL=32768
CONFIG_FREERTOS_HZ=100
CONFIG_LOG_DEFAULT_LEVEL_INFO=y
CONFIG_NVS_ASSERT_ERROR_CHECK=y
CONFIG_ESP_WIFI_DYNAMIC_TX_BUFFER=y
CONFIG_ESP_WIFI_TX_BUFFER_TYPE=1
CONFIG_ESP_WIFI_DYNAMIC_TX_BUFFER_NUM=32
# CONFIG_ESP_WIFI_STATIC_TX_BUFFER is not set
CONFIG_ESPTOOLPY_FLASHSIZE_16MB=y
CONFIG_ESPTOOLPY_FLASHSIZE="16MB"
# CONFIG_PARTITION_TABLE_SINGLE_APP is not set
# CONFIG_PARTITION_TABLE_TWO_OTA is not set
CONFIG_PARTITION_TABLE_CUSTOM=y
CONFIG_PARTITION_TABLE_CUSTOM_FILENAME="partitions_ota.csv"
```

## scenehub_node_v1/esp_idf/tests/node_runtime/sdkconfig.defaults
```kconfig
CONFIG_COMPILER_OPTIMIZATION_ASSERTION_LEVEL=2
CONFIG_ESP_SYSTEM_PANIC_PRINT_REBOOT=y
CONFIG_ESP_MAIN_TASK_STACK_SIZE=16384
CONFIG_ESP_SYSTEM_EVENT_TASK_STACK_SIZE=2304
CONFIG_ESP_TIMER_TASK_STACK_SIZE=3584
CONFIG_UNITY_ENABLE_IDF_TEST_RUNNER=y
CONFIG_SPIRAM=y
CONFIG_SPIRAM_BOOT_INIT=y
CONFIG_SPIRAM_MODE_OCT=y
CONFIG_SPIRAM_TYPE_ESPPSRAM64=y
CONFIG_SPIRAM_SPEED_80M=y
CONFIG_SPIRAM_USE_MALLOC=y
CONFIG_SPIRAM_ALLOW_STACK_EXTERNAL_MEMORY=y
```

## tests/command_backend/sdkconfig.defaults
```kconfig
CONFIG_SPIRAM=y
CONFIG_SPIRAM_MODE_OCT=y
CONFIG_SPIRAM_TYPE_AUTO=y
CONFIG_SPIRAM_SPEED_80M=y
CONFIG_SPIRAM_BOOT_INIT=y
CONFIG_SPIRAM_USE_MALLOC=y
CONFIG_SPIRAM_ALLOW_STACK_EXTERNAL_MEMORY=y
CONFIG_SPIRAM_ALLOW_BSS_SEG_EXTERNAL_MEMORY=y
CONFIG_DEFAULT_PSRAM_CLK_IO=30
CONFIG_DEFAULT_PSRAM_CS_IO=26
CONFIG_ESPTOOLPY_FLASHSIZE_4MB=y
CONFIG_ESPTOOLPY_FLASHSIZE="4MB"
CONFIG_PARTITION_TABLE_CUSTOM=y
CONFIG_PARTITION_TABLE_CUSTOM_FILENAME="partitions.csv"
CONFIG_PARTITION_TABLE_FILENAME="partitions.csv"
```
