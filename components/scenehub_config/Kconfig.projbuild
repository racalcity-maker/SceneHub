## components/scenehub_config/Kconfig.projbuild
```kconfig
menu "SceneHub Configuration"

choice SCENEHUB_AUDIO_OUTPUT_DRIVER
    prompt "Audio output driver"
    default SCENEHUB_AUDIO_OUTPUT_DRIVER_MAX98357A
    help
        Select the I2S output device profile used by the built-in audio player.
        Both profiles use standard I2S, but keeping an explicit selection lets
        the firmware apply codec-specific setup and logging.

config SCENEHUB_AUDIO_OUTPUT_DRIVER_PCM5102A
    bool "PCM5102A DAC"
    help
        Use this when the I2S output is wired to a PCM5102A DAC module.

config SCENEHUB_AUDIO_OUTPUT_DRIVER_MAX98357A
    bool "MAX98357A amplifier"
    help
        Use this when the I2S output is wired to a MAX98357A DAC/amplifier.

endchoice

config SCENEHUB_MAX98357A_SD_MODE_GPIO
    int "MAX98357A SD_MODE GPIO"
    default -1
    depends on SCENEHUB_AUDIO_OUTPUT_DRIVER_MAX98357A
    help
        Optional GPIO connected to MAX98357A SD_MODE.
        Set to -1 when SD_MODE is hardwired and cannot be controlled by the ESP.
        When connected, the audio output driver will force shutdown before
        stopping I2S clocks and release shutdown after I2S is enabled.

config SCENEHUB_I2S_BCK_PIN
    int "I2S BCLK GPIO"
    default 4
    help
        GPIO used for the I2S bit clock (BCK) line that feeds the selected
        audio output driver.

config SCENEHUB_I2S_WS_PIN
    int "I2S LRCK/WSEL GPIO"
    default 5
    help
        GPIO for the I2S word select / LRCLK line.

config SCENEHUB_I2S_DATA_PIN
    int "I2S DATA GPIO"
    default 6
    help
        GPIO used for the I2S data output towards the selected audio output device.

config SCENEHUB_SD_MISO_PIN
    int "SD card MISO GPIO"
    default 13
    help
        GPIO connected to the SD card MISO line (SPI mode).

config SCENEHUB_SD_MOSI_PIN
    int "SD card MOSI GPIO"
    default 11
    help
        GPIO connected to the SD card MOSI line (SPI mode).

config SCENEHUB_SD_CLK_PIN
    int "SD card CLK GPIO"
    default 12
    help
        GPIO connected to the SD card CLK line (SPI mode).

config SCENEHUB_SD_CS_PIN
    int "SD card CS GPIO"
    default 10
    help
        GPIO used for SD card chip select (SPI mode).

config SCENEHUB_MQTT_MAX_CLIENTS
    int "Maximum simultaneous MQTT clients"
    default 25
    range 1 64
    help
        Number of concurrent MQTT sessions the embedded broker accepts.
        Higher values increase PSRAM usage.

config SCENEHUB_MAX_ROOMS
    int "Maximum room slots"
    default 1
    range 1 4
    help
        Maximum number of room catalog/session slots compiled into the hub.
        Higher values increase static PSRAM usage because GM runtime state,
        prepared event references and read-model room projections scale with
        this value.

config SCENEHUB_EVENT_BUS_SKIP_EVENT_VALIDATION
    bool "Skip event bus event validation"
    default n
    help
        When disabled, event_bus validates each posted SceneHub event with
        scenehub_event_is_valid() before queueing it. Enable this only if you
        intentionally want to bypass domain event validation for performance or
        compatibility during development.

config SCENEHUB_SETUP_AP_PASSWORD
    string "Setup AP password"
    default "12345678"
    help
        Password used by the temporary scenehub-setup access point.
        WPA/WPA2 SoftAP requires at least 8 characters. Set this to an
        empty string only if you intentionally want an open setup AP.

config SCENEHUB_WEB_AUTH_DEFAULT_USER
    string "Default Web UI username"
    default "admin"
    help
        Username used for initial login to the Web UI. Change it
        after flashing or via the Settings tab.

config SCENEHUB_WEB_AUTH_DEFAULT_PASS
    string "Default Web UI password"
    default "admin"
    help
        Password used for initial login to the Web UI. After the
        device boots, change it from the Settings tab.

config SCENEHUB_WEB_AUTH_RESET_GPIO
    int "Web auth reset GPIO"
    default -1
    help
        When set to a valid GPIO number, holding this pin LOW for
        ~10 seconds resets the Web UI credentials back to the defaults.
        Set to -1 to disable the hardware reset feature.

config SCENEHUB_RELAY1_GPIO
    int "System relay 1 GPIO"
    default 15
    help
        GPIO used by system relay channel 1. Set to -1 to disable this channel.

config SCENEHUB_RELAY2_GPIO
    int "System relay 2 GPIO"
    default 16
    help
        GPIO used by system relay channel 2. Set to -1 to disable this channel.

config SCENEHUB_RELAY3_GPIO
    int "System relay 3 GPIO"
    default 17
    help
        GPIO used by system relay channel 3. Set to -1 to disable this channel.

config SCENEHUB_RELAY4_GPIO
    int "System relay 4 GPIO"
    default 18
    help
        GPIO used by system relay channel 4. Set to -1 to disable this channel.

config SCENEHUB_RELAY_ACTIVE_LOW
    bool "System relay module active low"
    default y
    help
        Enable when the relay module inputs turn ON at LOW level. Safe OFF will
        be HIGH for all relay channels. Disable for active-high relay modules.

config SCENEHUB_RELAY_MAX_PULSE_MS
    int "System relay max pulse duration ms"
    default 60000
    range 10 600000
    help
        Maximum accepted pulse duration for system relay commands. Larger
        values are rejected by the command executor.

config SCENEHUB_MOSFET1_GPIO
    int "System MOSFET 1 GPIO"
    default -1
    help
        GPIO used by system MOSFET/PWM channel 1. Set to -1 to disable this channel.

config SCENEHUB_MOSFET2_GPIO
    int "System MOSFET 2 GPIO"
    default -1
    help
        GPIO used by system MOSFET/PWM channel 2. Set to -1 to disable this channel.

config SCENEHUB_MOSFET3_GPIO
    int "System MOSFET 3 GPIO"
    default -1
    help
        GPIO used by system MOSFET/PWM channel 3. Set to -1 to disable this channel.

config SCENEHUB_MOSFET4_GPIO
    int "System MOSFET 4 GPIO"
    default -1
    help
        GPIO used by system MOSFET/PWM channel 4. Set to -1 to disable this channel.

config SCENEHUB_MOSFET_PWM_FREQ_HZ
    int "System MOSFET PWM frequency"
    default 1000
    range 100 40000
    help
        LEDC PWM frequency for system MOSFET channels.

config SCENEHUB_MOSFET_MAX_PULSE_MS
    int "System MOSFET max pulse duration ms"
    default 60000
    range 10 600000
    help
        Maximum accepted pulse duration for system MOSFET commands. Larger
        values are rejected by the command executor.

config SCENEHUB_MOSFET_MAX_FADE_MS
    int "System MOSFET max fade duration ms"
    default 60000
    range 0 600000
    help
        Maximum accepted fade duration for system MOSFET commands. Set to 0
        only if instant fades are the only allowed fade command.

config SCENEHUB_GPIO1_GPIO
    int "IO 1 board pin"
    default -1
    help
        Board pin used by universal IO channel 1. Set to -1 to disable.

config SCENEHUB_GPIO2_GPIO
    int "IO 2 board pin"
    default -1
    help
        Board pin used by universal IO channel 2. Set to -1 to disable.

config SCENEHUB_GPIO3_GPIO
    int "IO 3 board pin"
    default -1
    help
        Board pin used by universal IO channel 3. Set to -1 to disable.

config SCENEHUB_GPIO4_GPIO
    int "IO 4 board pin"
    default -1
    help
        Board pin used by universal IO channel 4. Set to -1 to disable.

config SCENEHUB_GPIO1_MODE
    int "IO 1 mode"
    default 0
    range 0 2
    help
        0 = disabled, 1 = digital input, 2 = digital output.

config SCENEHUB_GPIO2_MODE
    int "IO 2 mode"
    default 0
    range 0 2
    help
        0 = disabled, 1 = digital input, 2 = digital output.

config SCENEHUB_GPIO3_MODE
    int "IO 3 mode"
    default 0
    range 0 2
    help
        0 = disabled, 1 = digital input, 2 = digital output.

config SCENEHUB_GPIO4_MODE
    int "IO 4 mode"
    default 0
    range 0 2
    help
        0 = disabled, 1 = digital input, 2 = digital output.

config SCENEHUB_GPIO_ACTIVE_LOW
    bool "Universal IO active low"
    default n
    help
        Applies to universal IO logical active state. For output mode, active
        true writes LOW when enabled. For input mode, LOW is active when enabled.

config SCENEHUB_GPIO_PULLUP
    bool "Enable universal IO input pull-up"
    default n
    help
        Enable internal pull-up for universal IO channels configured as input.

config SCENEHUB_GPIO_PULLDOWN
    bool "Enable universal IO input pull-down"
    default n
    help
        Enable internal pull-down for universal IO channels configured as input.

config SCENEHUB_GPIO_DEBOUNCE_MS
    int "Universal IO input debounce ms"
    default 30
    range 1 1000
    help
        Stable time required before a universal IO input change is accepted.

config SCENEHUB_GPIO_MAX_PULSE_MS
    int "Universal IO max pulse duration ms"
    default 60000
    range 10 600000
    help
        Maximum accepted pulse duration for universal IO output commands.

config SCENEHUB_HARDWARE_MAX_EFFECT_MS
    int "Built-in hardware max effect duration ms"
    default 600000
    range 10 3600000
    help
        Maximum accepted total duration for relay, MOSFET and universal IO
        effect commands.

endmenu
```

## scenehub_node_v1/esp_idf/components/node_board/Kconfig
```kconfig
menu "SceneHub Node board profile"

config SCENEHUB_NODE_FACTORY_PIN_PROFILE
    bool "Enable factory pin profile"
    default n
    help
        Enable compile-time factory pin configuration for boxed hardware.
        When disabled, functional pins stay disabled by default and can be
        configured through provisioning/runtime config.

config SCENEHUB_NODE_FACTORY_PIN_LOCKED
    bool "Lock pin configuration in UI/API"
    depends on SCENEHUB_NODE_FACTORY_PIN_PROFILE
    default y
    help
        Mark pin configuration as factory-owned. Provisioning UI should hide or
        disable pin editing when this option is enabled.

config SCENEHUB_NODE_FACTORY_RELAY1_GPIO
    int "Factory relay 1 GPIO"
    depends on SCENEHUB_NODE_FACTORY_PIN_PROFILE
    default -1

config SCENEHUB_NODE_FACTORY_RELAY2_GPIO
    int "Factory relay 2 GPIO"
    depends on SCENEHUB_NODE_FACTORY_PIN_PROFILE
    default -1

config SCENEHUB_NODE_FACTORY_RELAY3_GPIO
    int "Factory relay 3 GPIO"
    depends on SCENEHUB_NODE_FACTORY_PIN_PROFILE
    default -1

config SCENEHUB_NODE_FACTORY_RELAY4_GPIO
    int "Factory relay 4 GPIO"
    depends on SCENEHUB_NODE_FACTORY_PIN_PROFILE
    default -1

config SCENEHUB_NODE_FACTORY_RELAY5_GPIO
    int "Factory relay 5 GPIO"
    depends on SCENEHUB_NODE_FACTORY_PIN_PROFILE
    default -1

config SCENEHUB_NODE_FACTORY_RELAY6_GPIO
    int "Factory relay 6 GPIO"
    depends on SCENEHUB_NODE_FACTORY_PIN_PROFILE
    default -1

config SCENEHUB_NODE_FACTORY_RELAY7_GPIO
    int "Factory relay 7 GPIO"
    depends on SCENEHUB_NODE_FACTORY_PIN_PROFILE
    default -1

config SCENEHUB_NODE_FACTORY_RELAY8_GPIO
    int "Factory relay 8 GPIO"
    depends on SCENEHUB_NODE_FACTORY_PIN_PROFILE
    default -1

config SCENEHUB_NODE_FACTORY_RELAY_ACTIVE_LOW
    bool "Factory relays are active-low"
    depends on SCENEHUB_NODE_FACTORY_PIN_PROFILE
    default y

config SCENEHUB_NODE_FACTORY_MOSFET1_GPIO
    int "Factory MOSFET 1 GPIO"
    depends on SCENEHUB_NODE_FACTORY_PIN_PROFILE
    default -1

config SCENEHUB_NODE_FACTORY_MOSFET2_GPIO
    int "Factory MOSFET 2 GPIO"
    depends on SCENEHUB_NODE_FACTORY_PIN_PROFILE
    default -1

config SCENEHUB_NODE_FACTORY_MOSFET3_GPIO
    int "Factory MOSFET 3 GPIO"
    depends on SCENEHUB_NODE_FACTORY_PIN_PROFILE
    default -1

config SCENEHUB_NODE_FACTORY_MOSFET4_GPIO
    int "Factory MOSFET 4 GPIO"
    depends on SCENEHUB_NODE_FACTORY_PIN_PROFILE
    default -1

config SCENEHUB_NODE_FACTORY_MOSFET5_GPIO
    int "Factory MOSFET 5 GPIO"
    depends on SCENEHUB_NODE_FACTORY_PIN_PROFILE
    default -1

config SCENEHUB_NODE_FACTORY_MOSFET6_GPIO
    int "Factory MOSFET 6 GPIO"
    depends on SCENEHUB_NODE_FACTORY_PIN_PROFILE
    default -1

config SCENEHUB_NODE_FACTORY_MOSFET7_GPIO
    int "Factory MOSFET 7 GPIO"
    depends on SCENEHUB_NODE_FACTORY_PIN_PROFILE
    default -1

config SCENEHUB_NODE_FACTORY_MOSFET8_GPIO
    int "Factory MOSFET 8 GPIO"
    depends on SCENEHUB_NODE_FACTORY_PIN_PROFILE
    default -1

config SCENEHUB_NODE_FACTORY_MOSFET_ACTIVE_LOW
    bool "Factory MOSFET outputs are active-low"
    depends on SCENEHUB_NODE_FACTORY_PIN_PROFILE
    default n

config SCENEHUB_NODE_FACTORY_IO1_GPIO
    int "Factory universal IO 1 GPIO"
    depends on SCENEHUB_NODE_FACTORY_PIN_PROFILE
    default -1

config SCENEHUB_NODE_FACTORY_IO1_ROLE
    int "Factory universal IO 1 role: 0 disabled, 1 input, 2 output"
    depends on SCENEHUB_NODE_FACTORY_PIN_PROFILE
    range 0 2
    default 0

config SCENEHUB_NODE_FACTORY_IO2_GPIO
    int "Factory universal IO 2 GPIO"
    depends on SCENEHUB_NODE_FACTORY_PIN_PROFILE
    default -1

config SCENEHUB_NODE_FACTORY_IO2_ROLE
    int "Factory universal IO 2 role: 0 disabled, 1 input, 2 output"
    depends on SCENEHUB_NODE_FACTORY_PIN_PROFILE
    range 0 2
    default 0

config SCENEHUB_NODE_FACTORY_IO3_GPIO
    int "Factory universal IO 3 GPIO"
    depends on SCENEHUB_NODE_FACTORY_PIN_PROFILE
    default -1

config SCENEHUB_NODE_FACTORY_IO3_ROLE
    int "Factory universal IO 3 role: 0 disabled, 1 input, 2 output"
    depends on SCENEHUB_NODE_FACTORY_PIN_PROFILE
    range 0 2
    default 0

config SCENEHUB_NODE_FACTORY_IO4_GPIO
    int "Factory universal IO 4 GPIO"
    depends on SCENEHUB_NODE_FACTORY_PIN_PROFILE
    default -1

config SCENEHUB_NODE_FACTORY_IO4_ROLE
    int "Factory universal IO 4 role: 0 disabled, 1 input, 2 output"
    depends on SCENEHUB_NODE_FACTORY_PIN_PROFILE
    range 0 2
    default 0

config SCENEHUB_NODE_FACTORY_IO5_GPIO
    int "Factory universal IO 5 GPIO"
    depends on SCENEHUB_NODE_FACTORY_PIN_PROFILE
    default -1

config SCENEHUB_NODE_FACTORY_IO5_ROLE
    int "Factory universal IO 5 role: 0 disabled, 1 input, 2 output"
    depends on SCENEHUB_NODE_FACTORY_PIN_PROFILE
    range 0 2
    default 0

config SCENEHUB_NODE_FACTORY_IO6_GPIO
    int "Factory universal IO 6 GPIO"
    depends on SCENEHUB_NODE_FACTORY_PIN_PROFILE
    default -1

config SCENEHUB_NODE_FACTORY_IO6_ROLE
    int "Factory universal IO 6 role: 0 disabled, 1 input, 2 output"
    depends on SCENEHUB_NODE_FACTORY_PIN_PROFILE
    range 0 2
    default 0

config SCENEHUB_NODE_FACTORY_IO7_GPIO
    int "Factory universal IO 7 GPIO"
    depends on SCENEHUB_NODE_FACTORY_PIN_PROFILE
    default -1

config SCENEHUB_NODE_FACTORY_IO7_ROLE
    int "Factory universal IO 7 role: 0 disabled, 1 input, 2 output"
    depends on SCENEHUB_NODE_FACTORY_PIN_PROFILE
    range 0 2
    default 0

config SCENEHUB_NODE_FACTORY_IO8_GPIO
    int "Factory universal IO 8 GPIO"
    depends on SCENEHUB_NODE_FACTORY_PIN_PROFILE
    default -1

config SCENEHUB_NODE_FACTORY_IO8_ROLE
    int "Factory universal IO 8 role: 0 disabled, 1 input, 2 output"
    depends on SCENEHUB_NODE_FACTORY_PIN_PROFILE
    range 0 2
    default 0

config SCENEHUB_NODE_FACTORY_LED1_GPIO
    int "Factory LED strip 1 GPIO"
    depends on SCENEHUB_NODE_FACTORY_PIN_PROFILE
    default -1

config SCENEHUB_NODE_FACTORY_LED1_PIXELS
    int "Factory LED strip 1 pixel count"
    depends on SCENEHUB_NODE_FACTORY_PIN_PROFILE
    range 1 1024
    default 30

config SCENEHUB_NODE_FACTORY_LED2_GPIO
    int "Factory LED strip 2 GPIO"
    depends on SCENEHUB_NODE_FACTORY_PIN_PROFILE
    default -1

config SCENEHUB_NODE_FACTORY_LED2_PIXELS
    int "Factory LED strip 2 pixel count"
    depends on SCENEHUB_NODE_FACTORY_PIN_PROFILE
    range 1 1024
    default 30

endmenu
```
